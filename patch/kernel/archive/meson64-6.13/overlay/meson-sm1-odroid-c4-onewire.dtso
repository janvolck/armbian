/dts-v1/;
/plugin/;

/ {
	compatible = "hardkernel,odroid-c4", "amlogic,sm1";

	fragment@0 {
		target-path = "/";

		__overlay__ {
			w1: onewire@0 {
				status = "okay";
				compatible = "w1-gpio";
				gpios = <&gpio 72 6>; // GPIOX_7
				pinctrl-names = "default";
			};
		};
	};

};
